## io_uring/Kconfig
```kconfig
# SPDX-License-Identifier: GPL-2.0-only
#
# io_uring configuration
#

config IO_URING_ZCRX
	def_bool y
	depends on IO_URING
	depends on PAGE_POOL
	depends on INET
	depends on NET_RX_BUSY_POLL

config IO_URING_BPF
	def_bool y
	depends on BPF
	depends on NET

config IO_URING_OPAQUE_OBJ
	bool "io_uring opaque TCP payload objects"
	default n
	depends on IO_URING && INET
	select SOCK_RX_OWNER
	help
	  Retain immutable TCP payloads as kernel-resident objects that can
	  be inspected, transmitted and compacted through io_uring. No network
	  device zerocopy support or mapped receive area is required.
	  Applications manage payload lifetime through generation handles.

config IO_URING_BPF_OPS
	def_bool y
	depends on IO_URING
	depends on BPF_SYSCALL && BPF_JIT && DEBUG_INFO_BTF

config IO_URING_OPAQUE_OBJ_KUNIT_TEST
	bool "KUnit tests for io_uring opaque objects" if !KUNIT_ALL_TESTS
	depends on KUNIT && IO_URING_OPAQUE_OBJ
	default KUNIT_ALL_TESTS
	help
	  Check capture page identity and independent fallback copies,
	  backing-memory reservations, stable-handle compaction and lifetime
	  across replacement. The suite also checks cancellation rollback
	  and generation exhaustion. Results appear in the KUnit boot log.

config IO_URING_ZCRX_KUNIT_TEST
	bool "KUnit tests for the MAIO mode of io_uring zero-copy receive" if !KUNIT_ALL_TESTS
	depends on KUNIT && IO_URING_ZCRX
	default KUNIT_ALL_TESTS
	help
	  Check the page states of the provider of readable pages, the lookup
	  of a page in the area, the refill ring, the fallback pages, the
	  teardown and the conversion of the receive queues of a device. The
	  tests need no network hardware. Results appear in the KUnit boot log.
```
